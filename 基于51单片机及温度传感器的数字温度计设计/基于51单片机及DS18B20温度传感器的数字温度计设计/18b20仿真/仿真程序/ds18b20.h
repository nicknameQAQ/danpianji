/********************************************************************
* 程序名;  __ds18b20_h__
* 功  能： DS18B20的c51编程头文件
*          
* 编程者： ZPZ
* 编程时间：2009/10/2 
* 说  明：用到的全局变量是：无符号字符型变量temp(测得的温度整数部分),temp_d 
* (测得的温度小数部分)，标志位f（测量温度的标志位‘0’表示“正温度”‘1’表
* 示“负温度”），标志位f_max（上限温度的标志位‘0’表示“正温度”、‘1’表
* 示“负温度”），标志位f_min（下限温度的标志位‘0’表示“正温度”、‘1’表
* 示“负温度”），标志位w(报警标志位‘1’启动报警‘0’关闭报警)。		   
*********************************************************************/
#ifndef __ds18b20_h__				  //定义头文件
#define __ds18b20_h__

#define uint unsigned int 	  		  //变量类型宏定义，用uint表示无符号整形（16位）
#define uchar unsigned char		 	  //变量类型宏定义，用uchar表示无符号字符型（8位）

sbit    DQ= P2^3;					  //可位寻址变量定义，用DQ表示P2.3口
sbit    beer=P1^0;				 	  //用beer表示P1.0
sbit    led=P1^1;					  //用led表示P1.1
uchar   temp=0; 			          //测量温度的整数部分
uchar   temp_d=0; 		              //测量温度的小数部
bit     f=0;						  //测量温度的标志位,0’表示“正温度”‘1’表示“负温度”）
bit     f_max=0;					  //上限温度的标志位‘0’表示“正温度”‘1’表示“负温度”）
bit     f_min=0;					  //下限温度的标志位‘0’表示“正温度”、‘1’表示“负温度”）
bit     w=0;						  //报警标志位‘1’启动报警‘0’关闭报警)
/*****************************延时子函数******************************/
void ds18b20_delayus(uint t)          //延时几μs
{
   while(t--);
}

void ds18b20_delayms(uint t)		  //延时1ms左右
{
	uint i,j;
	for(i=t;i>0;i--)
    	for(j=120;j>0;j--);
}
/**************************ds18b20初始化函数*************************/
void ds18b20_init()					 // DS18B20初始化
{ 
	uchar c=0;  
	DQ=1;
	DQ=0;						    //控制器向DS18B20发低电平脉冲
	ds18b20_delayus(80);		    //延时15-80μs
	DQ=1;							//控制器拉高总线，
	while(DQ);		   				//等待DS18B20拉低总线，在60-240μs之间
	ds18b20_delayus(150);			//延时，等待上拉电阻拉高总线
	DQ=1;							 //拉高数据线，准备数据传输；
}

/***************************ds18b20字节读函数************************/
uchar ds18b20_read()				 //DS18B20 字节读取
{
	uchar i;
	uchar d = 0;
	DQ = 1;							//准备读；
	for(i=8;i>0;i--)
	{	
	    d >>= 1;   //低位先发；
		DQ = 0;									
		_nop_();
		_nop_();				
		DQ = 1;						//必须写1，否则读出来的将是不预期的数据；
		if(DQ)						//在12us处读取数据；
			d |= 0x80;
		ds18b20_delayus(10);		
		}
	return d;						 //返回读取的值
}

/*************************ds18b20字节写函数**************************/
void ds18b20_write(uchar d)			 // ds18b20字节写
{
     uchar  i;
     for(i=8;i>0;i--)
     {        
		  DQ=0;
		  DQ=d&0x01;
		  ds18b20_delayus(5);
		  DQ=1;	
		  d >>= 1;         
     }
}

/***************************获取温度函数****************************/
 void get_temperature(bit flag)		
{
	uchar a=0,b=0,c=0,d=0;
    uint i;	
	ds18b20_init();				    //DS18B20初始化
	ds18b20_write(0xcc);			//向DS18B20发跳过读ROM命令
	ds18b20_write(0x44);			//写启动DS18B20进行温度转换命令，转换结果存入内部RAM
	if(flag==1)
	{								//首次启动DS18B20进行温度转换需要500ms,若转换时间不够就出错，读出的是85度的错误值。
	  display1(1);					//用开机动画耗时
	}
	else
	ds18b20_delayms(1);				
	ds18b20_init();			        //DS18B20初始化
	ds18b20_write(0xcc); 			//向DS18B20发跳过读ROM命令
	ds18b20_write(0xbe);			//写读内部RAM中9字节的内容命令
	a=ds18b20_read();				//读内部RAM （LSB）
	b=ds18b20_read();				//读内部RAM （MSB）
	if(flag==1)						//局部位变量f=1时读上下线报警温度
	{
	    max=ds18b20_read();		    //读内部RAM （TH）
	    min=ds18b20_read();		    //读内部RAM （Tl）
		
	}
	if((max&0x80)==0x80)		    //若读取的上限温度的最高位（符号位）为‘1’表明是负温度
	{f_max=1;max=(max-0x80);}       //将上限温度符号标志位置‘1’表示负温度，将上限温度装换成无符号数。
	 if((min&0x80)==0x80)	 	    //若读取的下限温度的最高位（符号位）为‘1’表明是负温度
	{f_min=1;min=(min-0x80);}       //将下限温度符号标志位置‘1’表示负温度，将下限温度装换成无符号数。
	 	
	i=b;
	i>>=4;
	if (i==0)
		{
        f=0;    					//i为0，正温度,设立正温度标记
        temp=((a>>4)|(b<<4));		//整数部分
       	a=(a&0x0f);
       	temp_d=a;					//小数部分
		}
	else
		{
       	f=1;    					//i为1，负温度,设立负温度标记
       	a=~a+1;
       	b=~b;
       	temp=((a>>4)|(b<<4));					//整数部分
       	a=(a&0x0f);					//小数部分
       	temp_d=a;
    	}
}
/*************************存储极限温度函数***************************/ 
void store_t()
 {
	if(f_max==1)					 //若上限温度为负，将上限温度转换成有符号数（最高位为1是负，为0是正）
	max=max+0x80;
	if(f_min==1)					 //若下限温度为负，将上限温度转换成有符号数
	min=min+0x80; 

	ds18b20_init();			         //DS18B20初始化
	ds18b20_write(0xcc); 			 //向DS18B20发跳过读ROM命令
	ds18b20_write(0x4e);			 //向DS18B20发写字节至暂存器2和3（TH和TL）命令
	ds18b20_write(max);			     //向暂存器TH（上限温度暂存器）写温度
	ds18b20_write(min);			     //向暂存器TL（下限温度暂存器）写温度
	ds18b20_write(0xff);			 //向配置寄存器写命令，进行温度值分辨率设置
	ds18b20_init();			         //DS18B20初始化
	ds18b20_write(0xcc); 			 //向DS18B20发跳过读ROM命令
	ds18b20_write(0x48);			 //向DS18B20发将RAM中2、3字节的内容写入EEPROM
 }									 //DS18B20上电后会自动将EEPROM中的上下限温度拷贝到TH、TL暂存器
 

/**************************温度超限报警函数*************************/
 void alarm()
 {									 //若上限值是正值
	  if(f_max==0)
	  {
	     if(f_min==0)				 //若下限值是正值
		 {
			 if(f==0)				 //若测量值是正值
			 {
				 if(temp<=min||temp>=max)
				 {w=1;TR1=1;}		 //当测量值小于最小值或大于最大值时报警
				 if((temp<max)&&(temp>min))
				 {w=0;}				 //当测量值大于最小值且小于最大值时不报警
			 }
			 if(f==1){w=1;TR1=1;}	 //若测量值是负值时报警
		 } 
	     if(f_min==1)				 //若下限值是负值
		 {
		 	 if(f==0)				 //若测量值是正值
			 {
				 if(temp>=max)//当测量值大于最大值时报警
				 {w=1;TR1=1;}
				 if(temp<max )//当测量值小于最大值时不报警
				 {w=0;}
			 }
			 if(f==1)				 //若测量值是负值
			 {
				 if(temp>=min)//当测量值大于最小值时报警
				 {w=1;TR1=1;}
				 if(temp<min)//当测量值小于最小值时不报警
				 {w=0;}
			 }
		 }
	  }

	  if(f_max==1)					 //若下限值是负值
	  {
	     if(f_min==1)				 //若下限值是负值
		 {
			 if(f==1)				 //若测量值是负值
			 {
				 if((temp<=max)||(temp>=min))
				 {w=1;TR1=1;}		 //当测量值小于最大值或大于最小值时报警
				 if((temp<min)&&(temp>max))
				 {w=0;}				 //当测量值小于最小值且大于最大值时不报警
			 }
			 if(f==0){w=1;TR1=1;}	 //若测量值是正值时报警
		 } 

	  }	  
 }

#endif