//#include <reg52.h>    //包含单片机寄存器的头文件
//#include <stdlib.h>   //包含随机函数rand()的定义文件
#include "intrins.h"  //包含_nop_()函数定义的头文件

sbit RS=P1^0;    //寄存器选择位，将RS位定义为P1.0引脚
sbit RW=P1^1;    //读写选择位，将RW位定义为P1.1引脚
sbit E=P1^2;     //使能信号位，将E位定义为P1.2引脚
sbit BF=P0^7;    //忙碌标志位，，将BF位定义为P0.7引脚

#define			line_1		0x80            // 第一行写入地址
#define			line_2		0x40            // 第二行写入地址
unsigned char number[11];
/*****************************************************
函数功能：延时1ms
(3j+2)*i=(3×33+2)×10=1010(微秒)，可以认为是1毫秒
***************************************************/
void delay1ms()
{
   unsigned char i,j;
	for(i=0;i<10;i++)
		for(j=0;j<33;j++)
			;		 
 }
 /*****************************************************
函数功能：延时若干毫秒
入口参数：n
***************************************************/
void delay(unsigned char n)
{
	unsigned char i;
	for(i=0;i<n;i++)
		delay1ms();
 }
/*****************************************************
函数功能：判断液晶模块的忙碌状态
返回值：result。result=1，忙碌;result=0，不忙
***************************************************/
unsigned char BusyTest(void)
{
	bit result;
	RS=0;       //根据规定，RS为低电平，RW为高电平时，可以读状态
    RW=1;
    E=1;        //E=1，才允许读写
    _nop_();   //空操作
    _nop_();
    _nop_(); 
    _nop_();   //空操作四个机器周期，给硬件反应时间	
    result=BF;  //将忙碌标志电平赋给result
	E=0;         //将E恢复低电平
	return result;
}
/*****************************************************
函数功能：将模式设置指令或显示地址写入液晶模块
入口参数：dictate
***************************************************/
void WriteInstruction (unsigned char dictate)
{
	while(BusyTest()==1); //如果忙就等待
	RS=0;                  //根据规定，RS和R/W同时为低电平时，可以写入指令
	RW=0;   
	E=0;                   //E置低电平(根据表8-6，写指令时，E为高脉冲，
                          // 就是让E从0到1发生正跳变，所以应先置"0"
	_nop_();
	_nop_();             //空操作两个机器周期，给硬件反应时间
	P0=dictate;            //将数据送入P0口，即写入指令或地址
	_nop_();
	_nop_();
	_nop_();
	_nop_();               //空操作四个机器周期，给硬件反应时间
	E=1;                   //E置高电平
	_nop_();
	_nop_();
	_nop_();
	_nop_();               //空操作四个机器周期，给硬件反应时间
	E=0;                  //当E由高电平跳变成低电平时，液晶模块开始执行命令
}
/*****************************************************
函数功能：指定字符显示的实际地址
入口参数：x
***************************************************/
void WriteAddress(unsigned char x)
{
	WriteInstruction(x|0x80); //显示位置的确定方法规定为"80H+地址码x"
}
/*****************************************************
函数功能：将数据(字符的标准ASCII码)写入液晶模块
入口参数：y(为字符常量)
***************************************************/
void WriteData(unsigned char y)
{
	while(BusyTest()==1);
	RS=1;           //RS为高电平，RW为低电平时，可以写入数据
	RW=0;
	E=0;            //E置低电平(根据表8-6，写指令时，E为高脉冲，
                       // 就是让E从0到1发生正跳变，所以应先置"0"
	P0=y;           //将数据送入P0口，即将数据写入液晶模块
	_nop_();
	_nop_();
 	_nop_();
    _nop_();       //空操作四个机器周期，给硬件反应时间
	E=1;          //E置高电平
	_nop_();
	_nop_();
	_nop_();
	_nop_();        //空操作四个机器周期，给硬件反应时间
	E=0;            //当E由高电平跳变成低电平时，液晶模块开始执行命令
}
/*****************************************************
函数功能：对LCD的显示模式进行初始化设置
***************************************************/
void LcdInitiate(void)
{
	delay(15);             //延时15ms，首次写指令时应给LCD一段较长的反应时间
	WriteInstruction(0x38);  //显示模式设置：16×2显示，5×7点阵，8位数据接口
	delay(5);               //延时5ms　，给硬件一点反应时间
	WriteInstruction(0x38);
	delay(5);
	WriteInstruction(0x38); //连续三次，确保初始化成功
	delay(5);
	WriteInstruction(0x0c);  //显示模式设置：显示开，无光标，光标不闪烁
	delay(5);
	WriteInstruction(0x06);  //显示模式设置：光标右移，字符不移
	delay(5);
	WriteInstruction(0x01);  //清屏幕指令，将以前的显示内容清除
	delay(5);
 }
/******打印手机号*****/
void display_number(unsigned char line,unsigned char num)
{
   unsigned char i=0;
   WriteAddress(line+num);	  //第一行第一列
   while(i!=11)	//只要没有写到结束标志，就继续写
   {
      WriteData(number[i]);	   
	  i++;
   }   
}
/*****************************************************************************
打印字符串程序（本函数调用指针函数）
向LCD发送一个字符串,长度48字符之内 
在第一行第一位处从左向右打印字符串
/****************************************************************************/
void Print_String(unsigned char line,unsigned char num,unsigned char  *str)
{
	WriteAddress(line+num);
	while(*str != '\0')
	{
		WriteData(*str++);
	}
	*str = 0;
}
