//头文件
#include <reg51.h>
#include <absacc.h> 
#include <stdio.h> 
#include <math.h> 
//变量类型宏定义
#define uchar unsigned char 
#define uint unsigned int 
uchar STH0; //定时器装入初值变量
uchar STL0; 
bit FY=0;   //放音标示位
uchar Song_Index=0,Tone_Index=0;  
uchar k, key; 
sbit SPK=P3^7 ; //蜂鸣器端口定义
sbit LED1=P1^0 ;//指示灯端口定义 
sbit LED2=P1^1 ; 
//播放音乐的乐谱数组
uchar code DSY_CODE[]={0xc0,0xf9,0xa4,0xb0,0x99,0x92,0x82,0xf8,0x80,0x90,
0x88,0x83,0xc6,0xa1,0x86,0x8e,0x89,0xa3,0x8c,0xc8};
uchar code Song[][50]= 
{ {1,2,3,1,1,2,3,1,3,4,5,3,4,5,5,6,5,3,5,6,5,3,5,3,2,1,2,1,-1},
{3,3,4,5,5,5,5,6,5,3,5,3,2,1,5,6,5,3,3,2,1,1,-1}, 
{3,2,1,3,2,1,1,2,3,2,1,2,3,1,3,4,5,3,4,5,5,6,5,3,5,3,2,1,3,2,1,1,-1},
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{1,2,3,4,5,6,7,8,9,10,11,12,13,14,15,16,17,18,19,20,21,-1}
};
uchar code Len[][50]= 
{{1,1,1,1,1,1,1,1,1,1,2,1,1,2,1,1,1,1,1,1,1,1,1,1,1,2,2,2,-1},
{1,1,1,1,1,1,2,1,1,1,1,1,1,1,2,1,1,1,1,1,1,2,2,-1}, 
{1,1,2,1,1,2,1,1,1,1,1,1,1,1,1,1,2,1,1,2,1,1,1,1,1,1,1,2,1,1,2,2,-1},
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{1,1,1,1,1,1,1,1,1,1,1,1,1,1,1,1,1,1,1,1,1,-1} 
};
uint code tab[]=
{0,63628,63835,64021,64103,64260,64400,64524, 
 64580,64684,64777,64820,64898,64968,65030, 
 65058,65110,65157,65178,65217,65252,65283 
};
//毫秒级延时子程序
void delay1 (uint ms)        
{
 uchar t;
 while (ms--) for (t=0;t<120;t++);
} 
//短暂延时子程序
 void delay(void) 
{ 
 uchar i; 
 for (i=300;i>0;i--); 
} 
//按键扫描子程序
 uchar getkey(void) 
 { 
   uchar scancode,tmpcode;
   if ((P0&0xf0)==0xf0)
      return (0);
   scancode = 0xfe; 
   while((scancode&0x10)!=0)    
   { 						
       P0=scancode;  
       if((P0&0xf0)!=0xf0)  
       { 
         tmpcode = (P0&0xf0)|0x0f;
         return((~scancode)+(~tmpcode));
       } 
       else scancode=(scancode<<1)|0x01;  
   } 
} 
void EXO_IXT() interrupt 0
{ 
  FY=0;LED1=1;LED2=0;
} 
void EX1_INT() interrupt 2
{ 
   FY=1;LED1=0;LED2=1;
}
//定时器0中断函数，用于蜂鸣器发出不同的声音
void time0_int(void) interrupt 1 using 0
{      
   TH0 = STH0; 
   TL0 = STL0; 
    SPK=!SPK;           
   P2=DSY_CODE[k];
} 
//主函数
void main(void)
{ LED1=1;
  LED2=0; 
  P2=0xc0;
  IE=0x87;
  TMOD=0x01;
  IT0=1;
  IT1=1;
  while(1)
   {
      P0=0xf0;    //按键按下判断 
      if((P0&0xf0)!=0xf0)   
        { 
         delay();     
         if((P0&0xf0)!=0xf0)    
          {
            key=getkey();   //读取按下的按键值
            switch(key)   
              {
              case 0x88:
	          k = 0;
                  break; 
              case 0x48:    
                  k = 1; 
                  break;                
               case 0x28:   
                  k = 2 ; 
                  break;  
              case 0x18:   
                  k = 3 ; 
                  break;  
              case 0x84:    
                  k = 4 ; 
                  break; 
              case 0x44:    
                  k = 5 ; 
                  break; 
              case 0x24:    
                  k = 6 ; 
                  break; 
              case 0x14:   
                  k = 7 ; 
                  break; 
              case 0x82:    
                  k = 8 ; 
                  break; 
              case 0x42:    
                  k = 9 ; 
                  break; 
              case 0x22:    
                  k = 10 ; 
                  break; 
              case 0x12:    
                  k = 11 ; 
                  break;
              case 0x81:    
                  k = 12 ; 
                  break; 
              case 0x41:    
                  k = 13 ; 
                  break; 
              case 0x21:    
                  k = 14 ; 
                  break; 
              case 0x11:    
                  k = 15 ; 
                  break; 
              default :
                  break; 
                       }
 if(FY==0)//在弹奏模式下，根据不同的键值蜂鸣器发出不同的声音
{
            STH0 = tab[k]/256;
            STL0 = tab[k]%256;
            TR0 = 1;                    
            while ((P0&0xf0)!=0xf0);  
            TR0=0;                  
            } 
              else 
               { 
                 while (FY==1) //在放音状态下，根据按键对应的曲目放音
                  { 
                   if(Song[k][Tone_Index]==-1) 
                 Tone_Index=0;
                   STH0=(tab[Song[k][Tone_Index]])/256;
                   STL0=(tab[Song[k][Tone_Index]])%256;
                   P2=DSY_CODE[Song[k][Tone_Index]]; 
                   TR0 = 1; 
                   delay1(300*Len[k][Tone_Index]); 
                   Tone_Index++; 
                  TR0=0; 
            }

          }
       }
     }
   }
}