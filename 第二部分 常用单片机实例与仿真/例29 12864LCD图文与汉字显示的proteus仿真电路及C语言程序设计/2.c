 #include<reg52.h>
#define LCD P0
unsigned char a,i,j,k;
int b;
sbit EN=P2^0;
sbit RW=P2^1;
sbit RS=P2^2;
sbit CS1=P2^3;
sbit CS2=P2^4;
sbit BUSY=P0^0;
void delay(unsigned char a);
unsigned char code ch2[95][16]={

{0x00,0x00,0x00,0x00,0x00,0x00,0x00,0x00,0x00,0x00,0x00,0x00,0x00,0x00,0x00,0x00},

{0x00,0x00,0x00,0xF8,0x00,0x00,0x00,0x00,0x00,0x00,0x00,0x33,0x30,0x00,0x00,0x00},
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{0x00,0x06,0x01,0x01,0x02,0x02,0x04,0x04,0x00,0x00,0x00,0x00,0x00,0x00,0x00,0x00},

};

unsigned char code XUEXIAO[12][16]={
{0x00,0x20,0x64,0x8C,0x60,0x00,0xE8,0x28,0x28,0xE8,0x28,0x08,0xF8,0x08,0x04,0x00},
{0x00,0x00,0x3C,0x03,0x00,0x00,0x07,0x02,0x02,0x03,0x00,0x20,0x3F,0x00,0x00,0x00},/*"河",0*/

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{0x00,0x00,0x04,0x04,0x04,0x04,0x24,0x3E,0x03,0x04,0x04,0x04,0x04,0x02,0x00,0x00},/*"学",5*/
};
unsigned char code XUEYUAN[16][16]={


{0x00,0x40,0x40,0xC2,0x4C,0x40,0x40,0x40,0x40,0x40,0xFE,0x40,0x40,0x40,0x00,0x00},
{0x00,0x00,0x00,0x1F,0x10,0x0C,0x04,0x00,0x00,0x00,0x3F,0x00,0x00,0x00,0x00,0x00},/*"计",0*/

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{0x00,0x10,0x08,0x04,0x02,0x01,0x00,0x7F,0x00,0x00,0x01,0x06,0x04,0x08,0x08,0x00},/*"术",7*/
};
unsigned char code xi[12][16]={
{0x00,0x40,0x70,0xA2,0xAC,0xA8,0xA2,0xAC,0xA8,0x90,0xA8,0xA6,0x62,0x20,0x10,0x00},
{0x00,0x00,0x04,0x04,0x04,0x04,0x24,0x3E,0x03,0x04,0x04,0x04,0x04,0x02,0x00,0x00},/*"学",0*/

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{0x00,0x20,0x10,0x11,0x09,0x05,0x21,0x61,0x3F,0x01,0x01,0x05,0x09,0x1B,0x10,0x00},/*"系",5*/
};

 char code zi0[8][64]={
0x00,0x00,0x00,0x00,0x00,0x00,0x00,0x00,
0x00,0x00,0x00,0x00,0x00,0x00,0x00,0x00,
0x00,0x00,0x00,0x80,0xC0,0xC0,0xE0,0xF0,
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0x08,0x06,0x01,0x00,0x00,0x00,0x00,0x00};
char code zi1[8][64]={

0x00,0x00,0x00,0x80,0xC0,0x40,0xA0,0x60,
0xA0,0x60,0xA0,0x40,0x80,0x40,0xA0,0x50,
0xA8,0x54,0x2C,0x16,0x2A,0x15,0x0B,0x15,
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0x00,0x00,0x00,0x00,0x00,0x00,0x00,0x00};
char code ch[8][128]={
0x00,0x00,0x00,0x00,0x00,0x00,0x00,0x00,0x00,0x00,0x00,0x00,0x00,0x00,0x00,0x00,
0x80,0x80,0x00,0xC0,0x00,0x00,0x00,0x66,0x70,0x40,0x80,0xF0,0xF8,0xFC,0xFE,0xFE,
0xFF,0xFF,0xFF,0x7F,0x7F,0x7F,0x7E,0x7E,0x7C,0x70,0xE0,0xE0,0xEF,0xE7,0xC3,0xC2,
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0x7F,0x7C,0x7C,0x78,0x10,0x00,0x00,0x00,0x00,0x00,0x00,0x00,0x00,0x00,0x00,0x00,
};

checkbusy()
{ EN=1;
  RW=1;
  RS=0;
  LCD=0XFF;
  if(BUSY);
}

writecode(unsigned char dat)  //写命令
{ checkbusy();
  EN=1;
  RW=0;
  RS=0;
  LCD=dat;
  EN=1;
  EN=0;
}
writedata(unsigned char dat)  //写数据
{ checkbusy();
  EN=1;
  RW=0;
  RS=1;
  LCD=dat;
  EN=1;
  EN=0;
}
void displayzifu(unsigned char page,unsigned char lineaddress,int n,  unsigned char table[])
{
 unsigned char  temp[16];
   if(lineaddress<0X80)
  {CS1=1;
  CS2=0;}
 
 
  for(j=0;j<n;j++)
    {  
    if(lineaddress>=0X80)
      {
      CS1=0;
        CS2=1;
       lineaddress=lineaddress-0X40;
       }
     b=table[j]-0X20;
     for(k=0;k<16;k++)
       {temp[k]=ch2[b][k];}

        writecode(page);
        writecode(lineaddress);
       for(i=0;i<8;i++)
         { writedata(temp[i]);}

       writecode(page+1);
       writecode(lineaddress);
       for(i=8;i<16;i++)
        { writedata(temp[i]);}
  lineaddress+=8;
// delay(200);
//		delay(200);
		delay(200);
 
    }
}
void clear(unsigned char page,unsigned char lineaddress,int n,  unsigned char table[])
{
 unsigned char  temp[16];
   if(lineaddress<0X80)
  {CS1=1;
  CS2=0;}
 
 
  for(j=0;j<n;j++)
    {  
    if(lineaddress>=0X80)
      {
      CS1=0;
        CS2=1;
       lineaddress=lineaddress-0X40;
       }
     b=table[j]-0X20;
     for(k=0;k<16;k++)
       {temp[k]=ch2[b][k];}

        writecode(page);
        writecode(lineaddress);
       for(i=0;i<8;i++)
         { writedata(temp[i]);}

       writecode(page+1);
       writecode(lineaddress);
       for(i=8;i<16;i++)
        { writedata(temp[i]);}
  lineaddress+=8;
 delay(20);
    }
}
void displayhanzi(unsigned char page,unsigned char lineaddress,int n,  unsigned char table[][16])
{
 unsigned char  temp[32];
   if(lineaddress<0X80)
  {CS1=1;
  CS2=0;}//left
 for(j=0;j<n;j++)
    { 
     if(lineaddress>=0X80)
     {
     CS1=0;//right
       CS2=1;
      lineaddress=lineaddress-0X40;
     }
 
   for(k=0;k<16;k++)
       {temp[k]=table[j][k];}
   j+=1;
   for(k=0;k<16;k++)
   {temp[16+k]=table[j][k];}

        writecode(page);
        writecode(lineaddress);
       for(i=0;i<16;i++)
         { writedata(temp[i]);}

       writecode(page+1);
       writecode(lineaddress);
       for(i=16;i<32;i++)
        { writedata(temp[i]);}

  lineaddress+=16;

//delay(200);
//		delay(200);
		delay(200);
 
 
    }



}
//满屏显示图片函数
void LCDDisplay(unsigned char page,unsigned char lineaddress, unsigned char table[8][128])
{
 
  
   for(i=0;i<8;i++)
    { 
      if(lineaddress<0X80)
         { 
            CS1=0;
            CS2=0;
          }
       writecode(page+i);
       writecode(lineaddress);
     for(j=0;j<64;j++)
       {    
       writedata(table[i][j]);
     lineaddress+=1;
 
     }
  
         if(lineaddress>=0X80)
          {
          CS1=0;
            CS2=1;
            lineaddress=lineaddress-0X40;
           }
         writecode(page+i);
             writecode(lineaddress);
                  for(j=64;j<128;j++)
             {
              writedata(table[i][j]);
        lineaddress+=1;

           }
      if(lineaddress>=0X80)
          {
         lineaddress=lineaddress-0X40;
           }
//delay(200);
//		delay(200);
//		delay(200);
delay(200);
		delay(200);
		delay(200);
	 
    }
}
 

void lcdinti()
{     writecode(0X3f);//显示开关关
    writecode(0XC0);//修改显示起始行
    writecode(0XB8);//修改页地址，x地址
    writecode(0X40);//修改列地址，y地址
     
}
void delay(unsigned char a)
	{
	unsigned char i,j;
	for(i=0;i<a;i++)
		for(j=0;j<200;j++)
			;
	}
 
main()
{ lcdinti();
 while(1)
	{
 
		
char table1[16]={"WELCOME TO:    "};
char table2[16]={"               "};
char table4[4]={"    "};
clear(0XB8,0X40,16,&table2);
clear(0XBa,0X40,16,&table2);
clear(0XBc,0X40,16,&table2);
clear(0XBe,0X40,16,&table2);
 
displayzifu(0XB8,0X40,16,&table1);
 
displayhanzi(0XBa,0X40,12,&XUEXIAO);
displayzifu(0XBa,0X98+8,4,&table4);
displayhanzi(0XBc,0X40,16,&XUEYUAN);

displayhanzi(0XBE,0X40,12,&xi);

displayzifu(0XBe,0X98+8,4,&table4); 
delay(200);
		delay(200);
		delay(200);
		delay(200);
		delay(200);
	 delay(200);
		delay(200);
		delay(200);
 // LCDDisplay12(0Xb8,0X80,&zi0);
lcdinti();
clear(0XB8,0X40,16,&table2);
clear(0XBa,0X40,16,&table2);
clear(0XBc,0X40,16,&table2);
clear(0XBe,0X40,16,&table2);
 LCDDisplay(0Xb8,0X40,&ch);
 delay(200);
		delay(200);
		delay(200);
		delay(200);
		delay(200);
		delay(200);
		delay(200);
		delay(200);
 
}
}


